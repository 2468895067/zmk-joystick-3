## config/Kconfig.shield
```kconfig
# Copyright (c) 2020 Ryan Cross
# SPDX-License-Identifier: MIT

config SHIELD_SOFLE_J
    def_bool $(shields_list_contains,sofle_J)

config SHIELD_SOFLE_RIGHT
    def_bool $(shields_list_contains,sofle_right)
```
